## boards/shields/adv/Kconfig.defconfig
```kconfig
if SHIELD_ADV_LEFT

config ZMK_KEYBOARD_NAME
    default "advWork"

config ZMK_SPLIT_ROLE_CENTRAL
    default y

endif 

if SHIELD_ADV_LEFT || SHIELD_ADV_RIGHT

config ZMK_SPLIT
    default y

endif
```

## config/west.yml
```yaml
manifest:

  remotes:

    - name: zmkfirmware

      url-base: https://github.com/zmkfirmware

    - name: zephyrproject

      url-base: https://github.com/zephyrproject-rtos

    - name: seeedstudio

      url-base: https://github.com/Seeed-Studio

  projects:

    - name: zmk

      remote: zmkfirmware

      revision: main

      import:

        file: app/west.yml

        name-blocklist:

          - zephyr

    - name: zephyr

      remote: zephyrproject

      revision: v4.4.0

      import: true

    - name: platform-seeedboards

      remote: seeedstudio

      revision: main

      path: modules/platform-seeedboard

  self:

    path: config
```
